## Kconfig
```kconfig
mainmenu "Zigbee Gas Counter"

source "Kconfig.zephyr"

menu "Gas counter application options"

config GAS_DEVICE_INIT_PRIORITY

	int "Wake capture init priority"
	default 60
	help
	  Initialization priority for early gas counter wakeup capture.

endmenu
```

## boards/arm/gas_counter_xiao_nrf52840/Kconfig.defconfig
```kconfig
# XIAO BLE board configuration

# Copyright (c) 2022 Marcin Niestroj
# SPDX-License-Identifier: Apache-2.0

if BOARD_GAS_COUNTER_XIAO_NRF52840

source "boards/common/usb/Kconfig.cdc_acm_serial.defconfig"

endif # BOARD_XIAO_BLE
```

## boards/arm/gas_counter_xiao_nrf52840/board.yml
```yaml
board:
  name: gas_counter_xiao_nrf52840
  full_name: Gas Counter XIAO nRF52840
  vendor: ihr
  socs:
    - name: nrf52840
```

## dts/bindings/power/gas-counter,xiao-battery-frontend.yaml
```yaml
description: XIAO nRF52840 battery measurement frontend

compatible: "gas-counter,xiao-battery-frontend"

properties:
  enable-gpios:
    type: phandle-array
    required: true
    description: |
      GPIO controlling the XIAO onboard battery measurement frontend.
      On XIAO nRF52840, P0.14 enables the battery voltage divider when driven low.
      The pin should normally be left high impedance and only driven low while
      measuring VBAT through P0.31/AIN7.
```
